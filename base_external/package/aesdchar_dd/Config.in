## base_external/package/aesdchar_dd/Config.in
```kconfig
config BR2_PACKAGE_AESDCHAR_DD
	bool "aesdchar_dd"
	help
	  Build and Install aesdchar device driver in rootfs
```

## base_external/package/ldd/Config.in
```kconfig
config BR2_PACKAGE_LDD
	bool "ldd"
	help
	  Includes the scull and faulty module in the kernel image
```
